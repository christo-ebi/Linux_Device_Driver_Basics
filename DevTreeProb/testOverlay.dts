/dts-v1/;
/plugin/;
/ {
    compatible = "brcm,bcm2837";
    fragment@0 {
        target-path = "/";
        __overlay__ {
            my_device {
                compatible = "custom,myPWM";
                status ="okay";
                label = "Test";
                my_value = <12>;
            };
        };
    };
};
